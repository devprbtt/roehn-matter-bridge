## sdkconfig.defaults
```kconfig
CONFIG_ESPTOOLPY_FLASHSIZE_4MB=y
CONFIG_BT_ENABLED=y
CONFIG_BT_NIMBLE_ENABLED=y
CONFIG_BT_NIMBLE_ENABLE_CONN_REATTEMPT=n
CONFIG_LWIP_IPV6_AUTOCONFIG=y
CONFIG_LWIP_HOOK_IP6_ROUTE_DEFAULT=y
CONFIG_LWIP_HOOK_ND6_GET_GW_DEFAULT=y
CONFIG_LWIP_IPV6_NUM_ADDRESSES=6
CONFIG_PARTITION_TABLE_CUSTOM=y
CONFIG_PARTITION_TABLE_FILENAME="partitions.csv"
CONFIG_PARTITION_TABLE_OFFSET=0xC000
CONFIG_ESP_MATTER_MAX_DYNAMIC_ENDPOINT_COUNT=128
CONFIG_ESP_WIFI_SOFTAP_SUPPORT=n
CONFIG_ENABLE_WIFI_AP=n
CONFIG_ENABLE_CHIP_SHELL=n
CONFIG_ENABLE_OTA_REQUESTOR=n
CONFIG_MBEDTLS_HKDF_C=y
```

## sdkconfig.defaults.esp32c6
```kconfig
CONFIG_ESPTOOLPY_FLASHSIZE_16MB=y
# CONFIG_ESPTOOLPY_FLASHSIZE_1MB is not set
# CONFIG_ESPTOOLPY_FLASHSIZE_2MB is not set
# CONFIG_ESPTOOLPY_FLASHSIZE_4MB is not set
# CONFIG_ESPTOOLPY_FLASHSIZE_8MB is not set
# CONFIG_ESPTOOLPY_FLASHSIZE_32MB is not set
# CONFIG_ESPTOOLPY_FLASHSIZE_64MB is not set
# CONFIG_ESPTOOLPY_FLASHSIZE_128MB is not set
CONFIG_ESPTOOLPY_FLASHSIZE="16MB"
CONFIG_USE_MINIMAL_MDNS=y
# CONFIG_ENABLE_ENDPOINT_QUEUE_FILTER is not set
```

## sdkconfig.defaults.esp32s3_n16r8
```kconfig
CONFIG_ESPTOOLPY_FLASHSIZE_16MB=y
CONFIG_ESPTOOLPY_FLASHSIZE="16MB"
# Enable external OPI PSRAM (N16R8 = 16MB flash + 8MB octal PSRAM)
CONFIG_ESP32S3_SPIRAM_SUPPORT=y
CONFIG_SPIRAM_MODE_OCT=y
CONFIG_SPIRAM_SPEED_80M=y
CONFIG_SPIRAM_BOOT_INIT=y
CONFIG_SPIRAM_USE_MALLOC=y
# Allocations <8KB stay in internal DRAM (BLE EMI, DMA buffers)
CONFIG_SPIRAM_MALLOC_ALWAYSINTERNAL=512
# Route WiFi/LwIP heap to PSRAM to free internal RAM for BLE
CONFIG_SPIRAM_TRY_ALLOCATE_WIFI_LWIP=y
# Move BSS/noinit segments marked for external memory into PSRAM to relieve DRAM
CONFIG_SPIRAM_ALLOW_BSS_SEG_EXTERNAL_MEMORY=y
CONFIG_SPIRAM_ALLOW_NOINIT_SEG_EXTERNAL_MEMORY=y
# Increase maximum dynamic endpoints so the bridge can expose many discovered lights
CONFIG_ESP_MATTER_MAX_DYNAMIC_ENDPOINT_COUNT=128
# Partition table kept as project default (partitions.csv)
```
